/dts-v1/;
/plugin/;

/ {
    compatible = "brcm,bcm2835";

    fragment@0 {
        target = <&i2c1>;
        __overlay__ {
            #address-cells = <1>;
            #size-cells = <0>;

            ads7128@48 {
                compatible = "ti,ads7128";
                reg = <0x13>; 
            };
        };
    };
};
